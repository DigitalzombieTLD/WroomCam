## main/Kconfig.projbuild
```kconfig
menu "WroomCam"

    menu "Wi-Fi"
        config WROOMCAM_WIFI_SSID
            string "Wi-Fi SSID"
            default "YOUR_WIFI_SSID"
            help
                Placeholder by default. Set it in the git-ignored sdkconfig.secrets file.

        config WROOMCAM_WIFI_PASSWORD
            string "Wi-Fi password (empty = open network)"
            default "YOUR_WIFI_PASSWORD"
            help
                Placeholder by default. Set it in the git-ignored sdkconfig.secrets file.

        config WROOMCAM_WIFI_MAX_RECONNECT
            int "Consecutive failed Wi-Fi attempts before rebooting (0 = never)"
            default 30
            range 0 1000

        config WROOMCAM_STATIC_IP
            bool "Use static IPv4 instead of DHCP"
            default n

        config WROOMCAM_IP_ADDR
            string "Static IPv4 address"
            default "192.168.1.50"
            depends on WROOMCAM_STATIC_IP

        config WROOMCAM_IP_GATEWAY
            string "Gateway"
            default "192.168.1.1"
            depends on WROOMCAM_STATIC_IP

        config WROOMCAM_IP_NETMASK
            string "Netmask"
            default "255.255.255.0"
            depends on WROOMCAM_STATIC_IP

        config WROOMCAM_IP_DNS
            string "DNS server"
            default "192.168.1.1"
            depends on WROOMCAM_STATIC_IP
    endmenu

    menu "Camera"
        choice WROOMCAM_CAM_FRAME_SIZE_CHOICE
            prompt "JPEG frame size"
            default WROOMCAM_CAM_SIZE_QVGA
            help
                OV2640 resolution (AI-Thinker ESP32-CAM, 4 MB PSRAM). Larger sizes lower the frame rate.

            config WROOMCAM_CAM_SIZE_QVGA
                bool "QVGA 320x240"
            config WROOMCAM_CAM_SIZE_VGA
                bool "VGA 640x480"
            config WROOMCAM_CAM_SIZE_SVGA
                bool "SVGA 800x600"
            config WROOMCAM_CAM_SIZE_XGA
                bool "XGA 1024x768"
            config WROOMCAM_CAM_SIZE_HD
                bool "HD 1280x720"
            config WROOMCAM_CAM_SIZE_SXGA
                bool "SXGA 1280x1024"
            config WROOMCAM_CAM_SIZE_UXGA
                bool "UXGA 1600x1200"
        endchoice

        config WROOMCAM_CAM_FRAME_SIZE
            int
            default 5 if WROOMCAM_CAM_SIZE_QVGA
            default 8 if WROOMCAM_CAM_SIZE_VGA
            default 9 if WROOMCAM_CAM_SIZE_SVGA
            default 10 if WROOMCAM_CAM_SIZE_XGA
            default 11 if WROOMCAM_CAM_SIZE_HD
            default 12 if WROOMCAM_CAM_SIZE_SXGA
            default 13 if WROOMCAM_CAM_SIZE_UXGA

        config WROOMCAM_CAM_JPEG_QUALITY
            int "JPEG quality (0-63, lower = better quality, larger frames)"
            default 12
            range 4 63

        config WROOMCAM_CAM_NUM_FRAME_BUFFERS
            int "Number of PSRAM frame buffers"
            default 2
            range 1 4

        config WROOMCAM_CAM_XCLK_MHZ
            int "Camera XCLK frequency (MHz)"
            default 20
            range 10 20
    endmenu

    menu "HTTP"
        config WROOMCAM_HTTP_PORT
            int "HTTP port"
            default 80
            range 1 65535

        config WROOMCAM_HTTP_SEND_TIMEOUT_S
            int "Socket send timeout (slow client is dropped after this)"
            default 5
            range 1 60

        config WROOMCAM_HTTP_FRAME_WAIT_S
            int "End the stream response if no frame arrives for this long (s)"
            default 15
            range 2 120
    endmenu

endmenu
```
